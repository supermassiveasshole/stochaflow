## examples/extension-projects/knowledge-distillation/experiments/tiny/sample.yaml
```yaml
sample:
  sampler: null
  options:
    weights: raw
    mean: 0.0
    std: 1.0
  shape: null
  num_samples: 8
  batch_size: 4
  seed: 42
  writers:
    - name: tensor
      params: {}
```
